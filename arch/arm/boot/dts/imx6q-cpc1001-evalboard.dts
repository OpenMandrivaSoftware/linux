/*
 * Copyright (C) 2013-2014 Freescale Semiconductor, Inc.
 *
 * This program is free software; you can redistribute it and/or modify
 * it under the terms of the GNU General Public License version 2 as
 * published by the Free Software Foundation.
 */

/dts-v1/;

#include "imx6q.dtsi"
#include "imx6qdl-cpc1001.dtsi"
#include "imx6qdl-cpc1001-evalboard.dtsi"

/ {
	model = "Fastwel CPC1001 Evaluation board";
	compatible = "fsl,imx6q-sabresd", "fsl,imx6q", "fsl-cpc1001";
};

