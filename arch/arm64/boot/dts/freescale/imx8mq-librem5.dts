// SPDX-License-Identifier: (GPL-2.0+ OR MIT)
// Copyright (C) 2020 Purism SPC <kernel@puri.sm>
//
// This is the old compat device tree for Birch, Chestnut and Aspen as shipped
// so far. It will always just include the imx8mq-librem5-r2.dts to preserve
// backward compatibility. Don't add any overrides here.

/dts-v1/;

#include "imx8mq-librem5-r2.dts"

/ {
	model = "Purism Librem 5";
	compatible = "purism,librem5", "fsl,imx8mq";
};
