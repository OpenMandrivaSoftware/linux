// SPDX-License-Identifier: (GPL-2.0+ OR MIT)
/ {
    mpp_srv: mpp-srv {
        compatible = "rockchip,mpp-service";
        rockchip,taskqueue-count = <12>;
        rockchip,resetgroup-count = <1>;
        status = "disabled";
    };

    vdpu: vdpu@fdb50400 {
        compatible = "rockchip,vpu-decoder-v2";
        reg = <0x0 0xfdb50400 0x0 0x400>;
        interrupts = <GIC_SPI 119 IRQ_TYPE_LEVEL_HIGH 0>;
        interrupt-names = "irq_vdpu";
        clocks = <&cru ACLK_VPU>, <&cru HCLK_VPU>;
        clock-names = "aclk_vcodec", "hclk_vcodec";
        rockchip,normal-rates = <594000000>, <0>;
        assigned-clocks = <&cru ACLK_VPU>;
        assigned-clock-rates = <594000000>;
        resets = <&cru SRST_A_VPU>, <&cru SRST_H_VPU>;
        reset-names = "shared_video_a", "shared_video_h";
        rockchip,skip-pmu-idle-request;
        rockchip,disable-auto-freq;
        iommus = <&vdpu_mmu>;
        rockchip,srv = <&mpp_srv>;
        rockchip,taskqueue-node = <0>;
        rockchip,resetgroup-node = <0>;
        power-domains = <&power RK3588_PD_VDPU>;
        status = "disabled";
    };

    vdpu_mmu: iommu@fdb50800 {
        compatible = "rockchip,rk3568-iommu";
        reg = <0x0 0xfdb50800 0x0 0x40>;
        interrupts = <GIC_SPI 118 IRQ_TYPE_LEVEL_HIGH 0>;
        interrupt-names = "irq_vdpu_mmu";
        clocks = <&cru ACLK_VPU>, <&cru HCLK_VPU>;
        clock-names = "aclk", "iface";
        power-domains = <&power RK3588_PD_VDPU>;
        #iommu-cells = <0>;
        status = "disabled";
    };
};