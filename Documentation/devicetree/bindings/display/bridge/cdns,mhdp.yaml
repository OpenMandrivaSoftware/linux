## Documentation/devicetree/bindings/display/bridge/cdns,mhdp.yaml
```yaml
# SPDX-License-Identifier: (GPL-2.0 OR BSD-2-Clause))
%YAML 1.2
---
$id: http://devicetree.org/schemas/display/bridge/cdns,mhdp.yaml#
$schema: http://devicetree.org/meta-schemas/core.yaml#

title: Cadence MHDP TX Encoder

maintainers:
  - Sandor Yu <Sandoryu@nxp.com>

description: |
  Cadence MHDP Controller supports one or more of the protocols,
  such as HDMI and DisplayPort.
  Each protocol requires a different FW binaries.

  This document defines device tree properties for the Cadence MHDP Encoder
  (CDNS MHDP TX). It doesn't constitue a device tree binding
  specification by itself but is meant to be referenced by platform-specific
  device tree bindings.

  When referenced from platform device tree bindings the properties defined in
  this document are defined as follows. The platform device tree bindings are
  responsible for defining whether each property is required or optional.

properties:
  reg:
    maxItems: 1
    description: Memory mapped base address and length of the MHDP TX registers.

  interrupts:
    maxItems: 2

  interrupt-names:
    - const: plug_in
      description: Hotplug detect interrupter for cable plugin event.
    - const: plug_out
      description: Hotplug detect interrupter for cable plugout event.

  port:
    type: object
    description: |
      The connectivity of the MHDP TX with the rest of the system is
      expressed in using ports as specified in the device graph bindings defined
      in Documentation/devicetree/bindings/graph.txt. The numbering of the ports
      is platform-specific.
```

## Documentation/devicetree/bindings/display/imx/mhdp.yaml
```yaml
# SPDX-License-Identifier: (GPL-2.0 OR BSD-2-Clause)
%YAML 1.2
---
$id: http://devicetree.org/schemas/display/bridge/mhdp.yaml#
$schema: http://devicetree.org/meta-schemas/core.yaml#

title: Cadence MHDP Encoder

maintainers:
  - Sandor Yu <Sandoryu@nxp.com>

description: |
  The MHDP transmitter is a Cadence HD Display TX controller IP
  with a companion PHY IP.
  The MHDP supports one or more of the protocols,
  such as HDMI(1.4 & 2.0), DisplayPort(1.2).
  switching between the two modes (HDMI and DisplayPort)
  requires reloading the appropriate FW

  These DT bindings follow the Cadence MHDP TX bindings defined in
  Documentation/devicetree/bindings/display/bridge/cdns,mhdp.yaml with the
  following device-specific properties.

Properties:
  compatible:
    enum:
      - nxp,imx8mq-cdns-hdmi
      - nxp,imx8mq-cdns-dp

  reg: See cdns,mhdp.yaml.

  interrupts: See cdns,mhdp.yaml.

  interrupt-names: See cdns,mhdp.yaml.

  ports: See cdns,mhdp.yaml.

Required:
  - compatible
  - reg
  - interrupts
  - interrupt-names
  - ports

Example:
  - |
    mhdp: mhdp@32c00000 {
      compatible = "nxp,imx8mq-cdns-hdmi";
      reg = <0x32c00000 0x100000>;
      interrupts = <GIC_SPI 16 IRQ_TYPE_LEVEL_HIGH>,
                   <GIC_SPI 25 IRQ_TYPE_LEVEL_HIGH>;
      interrupt-names = "plug_in", "plug_out";

      ports {
        mhdp_in: endpoint {
          remote-endpoint = <&dcss_out>;
        };
      };
    };
```

## Documentation/devicetree/bindings/pinctrl/fsl,imx8mq-pinctrl.txt
```
* Freescale IMX8MQ IOMUX Controller

Please refer to fsl,imx-pinctrl.txt and pinctrl-bindings.txt in this directory
for common binding part and usage.

=== Pin Controller Node ===

Required properties:
- compatible: "fsl,imx8mq-iomuxc"
- reg: Must contain the base physical address and size of the iomuxc registers.

=== Pin Configuration Node ===
Required properties:
- pinmux: Array of integersy, representing a group of pins mux setting.
	The format is pinmux = <PIN_FUNC_ID>, PIN_FUNC_ID is a pin working on
	a specific function.

	Refer to imx8mq-pinfunc.h in device tree source folder for all available
	imx8mq PIN_FUNC_ID.

Optional Properties:
- drive-strength		Integer: controls Drive Strength
					0: driver disabled
					1: 255 Ohm
					2: 105 Ohm
					3:  75 Ohm
					4:  85 Ohm
					5:  65 Ohm
					6:  45 Ohm
					7:  40 Ohm
- slew-rate:			Integer: controls Slew Rate
					0: Slow
					1: Medium
					2: Fast
					3: Maximum
- drive-open-drain		Bool: enable Open-drian
- bias-pull-up			Bool: enable Pull-up
- input-schmitt-enable		Bool: enable schmitt-trigger
- input-enable			Bool: enable input, overriding module settings
```
