## drivers/net/wireless/redpine/Kconfig
```kconfig
config WLAN_VENDOR_REDPINE
	bool "Redpine Signals Inc devices - PROPRIETARY DRIVER"
	default y
	help
	  If you have a wireless card belonging to this class, say Y.

	  Note that the answer to this question doesn't directly affect the
	  kernel: saying N will just cause the configurator to skip all
	  the questions about  cards. If you say Y, you will be asked for
	  your specific card in the following questions.

if WLAN_VENDOR_REDPINE

config REDPINE_91X
	tristate "Redpine Signals Inc 91x WLAN driver support"
	depends on MAC80211
	help
	  This option enabes support for REDPINE 1x1 devices.
	  Select M (recommended), if you have a REDPINE 1x1 wireless module.

config REDPINE_DEBUGFS
	bool "Redpine Signals Inc debug support"
	depends on REDPINE_91X
	default y
	help
	 Say Y, if you would like to enable debug support. This option
	 creates debugfs entries.

config REDPINE_SDIO
	tristate "Redpine Signals SDIO bus support"
	depends on MMC && REDPINE_91X
	default m
	help
	  This option enables the SDIO bus support in rsi drivers.
	  Select M (recommended), if you have a REDPINE 1x1 wireless module.

config REDPINE_USB
	tristate "Redpine Signals USB bus support"
	depends on USB && REDPINE_91X
	default m
	help
	  This option enables the USB bus support in rsi drivers.
	  Select M (recommended), if you have a REDPINE 1x1 wireless module.

config REDPINE_BT_ALONE
	bool "Redpine Signals BT alone (classic/LE) mode support"
	depends on REDPINE_91X
	default n
	help
	  This option enables the BT classic alone upport in rsi drivers.
	  Say Y, if you want to use this feature.

config REDPINE_COEX_MODE
	bool "Redpine Signals Wi-Fi BT Coex support"
	depends on REDPINE_91X
	default n
	help
	  This option enables the Wi-Fi BT coex support in rsi drivers.
	  Select Y, if you have to use this feature.

config REDPINE_WOW
	bool "Redpine Signals WoWLAN support"
	depends on REDPINE_91X
	default n
	help
	  This option enables the WoWLAN support.
	  Say Y if you want to use this feature.

config REDPINE_P2P
	bool "Redpine Signals Wi-Fi Direct support"
	depends on REDPINE_91X
	default n
	help
	  This option enables the Wi-Fi Direct support in rsi drivers.
	  Select Y, if you have to use this feature.

config HW_SCAN_OFFLOAD 
	bool "Redpine Signals Hardware scan offload feature"
	depends on REDPINE_91X
	default n
	help
	  This option enables the hardware scan offload option in rsi drivers.
	  Select Y, if you have to use this feature.

config CARACALLA_BOARD 
	bool "Redpine device support on Caracalla board"
	depends on REDPINE_91X
	default n
	help
	  This option is used to support Caracalla board with REDPINE driver.
	  Select Y, if you have to use this support.

config REDPINE_ZIGB 
	bool "Redpine device support on Zigbee"
	depends on REDPINE_91X && REDPINE_COEX_MODE
	default n
	help
	  This option is used to support Zigbee with REDPINE driver.
	  Select Y, if you have to use this support.

config REDPINE_PURISM
	bool "Redpine Signals PURISM FW support"
	depends on REDPINE_91X && REDPINE_COEX_MODE
	default n
	help
	  This option enables the PURISM FW support.
	  Say Y if you want to use this feature.

endif # WLAN_VENDOR_REDPINE
```

## drivers/soc/imx/Kconfig
```kconfig
menu "i.MX SoC drivers"

config IMX7_PM_DOMAINS
	bool "i.MX7 PM domains"
	depends on SOC_IMX7D || (COMPILE_TEST && OF)
	depends on PM
	select PM_GENERIC_DOMAINS
	default y if SOC_IMX7D

endmenu

if ARCH_MXC

if ARM64

config SOC_IMX8MQ
	bool "i.MX8MQ support"
	help
	  This enables support for the i.MX8MQ SoC.
endif

endif
```
